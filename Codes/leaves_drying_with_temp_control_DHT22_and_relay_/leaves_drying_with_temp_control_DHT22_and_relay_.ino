/*
   Controlling heat generated(heat is generated by  100W bulbs) to dry leaves.
   Tempeature reading of the sorrounding  taken by DHT sensor,.
   The whole control is achieved by on-off mechanism of the relay(turn on/off the bulbs)
   temperature readings and status are then updated on the LCD(I2C LCD)
   Buzzer and LEDs are used to give quick notification on the status
   
   Note: i2c pins on arduino uno and nano are
   sck---> A5
   dt----> A4

   Using built-in I2C scanner example(File->Examples->Wire->i2c scanner)
   scan its I2C address(this address is used when creating an instance of LiquidCrystal_I2C)
*/

//including the necessary libraries
#include <LiquidCrystal_I2C.h>
#include <Wire.h>
#include "DHT.h"

#define RELAY 11
#define TEMP_SENSOR A0
#define RED 9
#define GREEN 8
#define MAX_TEMP 65
#define MIN_TEMP 50
#define BUZZER_PIN 11
#define DHTTYPE DHT22    //max temp that can be measured is about 70c


const int numRows = 2, numCols = 16;
float temp_reading, last_reading;
bool relay_state = true; //keeping track of the relay state to ensure it is only turn on/off when required

//objects
DHT dht(TEMP_SENSOR, DHTTYPE);
LiquidCrystal_I2C lcd(0x27, numCols, numRows);


void setup() {

  lcd.begin();
  dht.begin();

  lcd.setCursor(2, 0);
  lcd.print("Project BY:");
  lcd.setCursor(6, 1);
  lcd.print("JOVINE");
  delay(1000);
  lcd.clear();


  pinMode(RELAY, OUTPUT);
  pinMode(RED, OUTPUT);
  pinMode(GREEN, OUTPUT);
  pinMode(BUZZER_PIN, OUTPUT);

  //turn of all the LEDs
  digitalWrite(RED, LOW);
  digitalWrite(GREEN, LOW);

  lcd.setCursor(0, 0);
  lcd.print("Temperature:");

  update_info(dht.readTemperature());
}

void loop() {
  // put your main code here, to run repeatedly:

  temp_reading = dht.readTemperature();

  if (temp_reading >= MAX_TEMP) {
    if (relay_state) {
      //turn off the relay
      digitalWrite(RELAY, LOW);
      //buzzing to indicate temperature is high and relay turn off
      tone(BUZZER_PIN, 250, 2000);
      update_info(temp_reading);
      relay_state = false;
    }
  }
  else {
    digitalWrite(RELAY, HIGH);
    digitalWrite(BUZZER_PIN, LOW);
    update_info(temp_reading);
    relay_state = true;
  }

}


void update_info(float temperature) {

  if (temperature != 0) {
    // only update whenever there is change in value
    if (last_reading != temperature) {
      lcd.setCursor(12, 0);
      lcd.print(temperature);
      lcd.setCursor(1, 1);

      if (temperature >= MIN_TEMP && temperature < MAX_TEMP) {
        lcd.print("SAFE");
        //green light on
        digitalWrite(RED, LOW);
        digitalWrite(GREEN, HIGH);
      } else {

        lcd.print("UNSAFE");
        //red light on
        digitalWrite(RED, HIGH);
        digitalWrite(GREEN, LOW);
      }
      delay(100);
      last_reading = temperature;
    }
  } else {
    // message to indicate checking of  connections to the sensor should be done
    lcd.setCursor(0, 0);
    lcd.print("check sensor...");
    lcd.setCursor(0, 1);
    lcd.print("plz, fix the sensor");
  }
}
